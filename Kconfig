## driver/arducam-mega/Kconfig
```kconfig
# ARDUCAM_MEGA

config VIDEO_ARDUCAM_MEGA
	bool "Arducam Mega CMOS digital image sensor"
	select SPI
	depends on DT_HAS_ARDUCAM_MEGA_ENABLED
	default y
	help
	  Enable driver for Arducam Mega CMOS digital image sensor device.
```

## drivers/arducam/Kconfig
```kconfig
#
# Copyright (c) 2023 Arribada Initative
#

menuconfig ARDUCAM_MEGA
	bool "Arducam Mega"
	default y
	depends on DT_HAS_ARDUCAM_ENABLED
	select SPI
	help
	  Enable driver for Arducam Mega camera.

if ARDUCAM_MEGA

config ARDUCAM_NAME
	string "Arducam Mega Driver's name"
	default "ARDUCAM_MEGA"
	help
	  This option sets the driver name.

endif # ARDUCAM_MEGA
```

## dts/bindings/arducam,mega.yaml
```yaml
description: Arducam Mega camera for microcontrollers

compatible: "arducam,mega"

include: [spi-device.yaml]
```

## dts/bindings/video/arducam,mega.yaml
```yaml
# Copyright (c) 2023 ArduCAM <www.arducam.com>
# SPDX-License-Identifier: Apache-2.0

description: Arducam Mega CMOS video sensor

compatible: "arducam,mega"

# properties:
#   nss-gpios:
#     type: phandle-array
#     description: |
#       The NSSn pin is asserted to stop SPI communication.
#       The sensor receives this as an active-low signal.
#     required: true

include: spi-device.yaml
```

## west.yml
```yaml
manifest:
  defaults:
    revision: main

  remotes:
    - name: zephyr
      url-base: https://github.com/zephyrproject-rtos/
    - name: arribada
      url-base: https://github.com/arribada/

  projects:
    - name: zephyr
      remote: zephyr
      path: zephyr
      revision: v3.6.0
      import:
        # By using name-allowlist we can clone only the modules that are
        # strictly needed by the application.
        name-allowlist:
          - cmsis # required by the ARM port
          - fatfs # required by file system
          - hal_rpi_pico
          - hal_espressif
    - name: arribada-custom-boards
      path: deps/arribada-custom-boards
      revision: v3.5.0
      url: https://github.com/arribada/custom-boards-zephyr

  self:
    path: arducam-driver-zephyr
```
